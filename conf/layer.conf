## conf/layer.conf
```bitbake
# We have a conf and classes directory, add to BBPATH
BBPATH .= ":${LAYERDIR}"

# We have recipes-* directories, add to BBFILES
BBFILES += "${LAYERDIR}/recipes-*/*/*.bb \
	${LAYERDIR}/recipes-*/*/*.bbappend \
"

BBFILE_COLLECTIONS += "replicape-layer"
BBFILE_PATTERN_replicape-layer := "^${LAYERDIR}/"
BBFILE_PRIORITY_replicape-layer = "6"

PREFERRED_PROVIDER_virtual/kernel = "linux-mainline-3.12"
PREFERRED_PROVIDER_linux-mainline = "linux-mainline-3.12"

PREFERRED_PROVIDERS_virtual/egl = "bb-sgx"
PREFERRED_PROVIDERS_virtual/libgles1 = "bb-sgx"
PREFERRED_PROVIDERS_virtual/libgles2 = "bb-sgx"
```

## conf/machine/beaglebone.conf
```bitbake
#@TYPE: Machine
#@NAME: BeagleBone machine
#@DESCRIPTION: Machine configuration for the http://beagleboard.org/bone board 

# Only has DVI connector for external screen
GUI_MACHINE_CLASS = "bigscreen"

require conf/machine/include/ti33x.inc

PREFERRED_PROVIDER_virtual/kernel = "linux-ti-staging"
PREFERRED_VERSION_linux-ti-staging = "3.14.14"
PREFERRED_PROVIDER_virtual/kernel-devicetree = "linux-ti-staging"
PREFERRED_PROVIDER_kernel-devicetree-overlays = "kernel-devicetree-overlays"
IMAGE_FSTYPES_append = " tar.xz "



# Guesswork
SERIAL_CONSOLE = "115200 ttyO0"

UBOOT_MACHINE = "am335x_evm_config"

# and sdio
MACHINE_FEATURES = "screen apm usbgadget usbhost vfat alsa"

# the kernel image needs to be in /boot
#MACHINE_ESSENTIAL_EXTRA_RDEPENDS = "kernel-devicetrees kernel-devicetree-overlays kernel-modules kernel-headers"

PREFERRED_PROVIDER_virtual/libgl = "mesa-gl"
PREFERRED_PROVIDER_virtual/egl = "libgles-omap3"
PREFERRED_PROVIDER_virtual/libgles1 = "libgles-omap3"
PREFERRED_PROVIDER_virtual/libgles2 = "libgles-omap3"
PREFERRED_PROVIDER_virtual/mesa = "mesa-gl"
```
